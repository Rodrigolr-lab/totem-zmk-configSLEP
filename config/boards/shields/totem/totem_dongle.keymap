/*
 * TOTEM dongle keymap.
 *
 * The dongle is the central and runs the keymap. Reuse the exact same keymap
 * as the halves by textually including it, so there is only one source of truth.
 */

#include "totem.keymap"
